/* Variable definitions for ESP32ULP linker
 * This file is generated automatically by esp32ulp_mapgen.py utility.
 */

PROVIDE ( ulp_battery_locked = 0x50000314 );
PROVIDE ( ulp_debug0 = 0x50000304 );
PROVIDE ( ulp_debug1 = 0x50000308 );
PROVIDE ( ulp_debug2 = 0x5000030c );
PROVIDE ( ulp_debug3 = 0x50000310 );
PROVIDE ( ulp_entry = 0x50000000 );
PROVIDE ( ulp_target_time0 = 0x50000300 );
PROVIDE ( ulp_target_time1 = 0x500002fc );
PROVIDE ( ulp_target_time2 = 0x500002f8 );
PROVIDE ( ulp_target_time3 = 0x500002f4 );
PROVIDE ( ulp_time_counter_lsb = 0x500002f0 );
PROVIDE ( ulp_time_counter_msb = 0x500002ec );
PROVIDE ( ulp_time_load_lsb = 0x500002e8 );
PROVIDE ( ulp_time_load_msb = 0x500002e4 );
PROVIDE ( ulp_wakeup_enable = 0x500002e0 );
